/*
 * This software is contributed or developed by KYOCERA Corporation.
 * (C) 2014 KYOCERA Corporation
 */
/* Copyright (c) 2014, The Linux Foundation. All rights reserved.
 *
 * This program is free software; you can redistribute it and/or modify
 * it under the terms of the GNU General Public License version 2 and
 * only version 2 as published by the Free Software Foundation.
 *
 * This program is distributed in the hope that it will be useful,
 * but WITHOUT ANY WARRANTY; without even the implied warranty of
 * MERCHANTABILITY or FITNESS FOR A PARTICULAR PURPOSE.  See the
 * GNU General Public License for more details.
 */

/*---------------------------------------------------------------------------
 * This file is autogenerated file using gcdb parser. Please do not edit it.
 * Update input XML file to add a new entry or update variable in this file
 * VERSION = "1.0"
 *---------------------------------------------------------------------------*/
&mdss_mdp {
	dsi_nt35590_720_vid: qcom,mdss_dsi_nt35590_720p_video {
		qcom,mdss-dsi-panel-name = "nt35590 720p video mode dsi panel";
		qcom,mdss-dsi-panel-controller = <&mdss_dsi0>;
		qcom,mdss-dsi-panel-type = "dsi_video_mode";
		qcom,mdss-dsi-panel-destination = "display_1";
		qcom,mdss-dsi-panel-framerate = <60>;
		qcom,mdss-dsi-virtual-channel-id = <0>;
		qcom,mdss-dsi-stream = <0>;
		qcom,mdss-dsi-panel-width = <540>;
		qcom,mdss-dsi-panel-height = <960>;
		qcom,mdss-dsi-h-front-porch = <20>;
		qcom,mdss-dsi-h-back-porch = <32>;
		qcom,mdss-dsi-h-pulse-width = <32>;
		qcom,mdss-dsi-h-sync-skew = <0>;
		qcom,mdss-dsi-v-back-porch = <10>;
		qcom,mdss-dsi-v-front-porch = <6>;
		qcom,mdss-dsi-v-pulse-width = <2>;
		qcom,mdss-dsi-h-left-border = <0>;
		qcom,mdss-dsi-h-right-border = <0>;
		qcom,mdss-dsi-v-top-border = <0>;
		qcom,mdss-dsi-v-bottom-border = <0>;
		qcom,mdss-dsi-bpp = <24>;
		qcom,mdss-dsi-underflow-color = <0x00>;
		qcom,mdss-dsi-border-color = <0>;

		qcom,mdss-dsi-on-command_ws1 = [39 01 00 00 00 00 04 B9 FF 83 89
							  39 01 00 00 00 00 03 BA 41 93
							  15 01 00 00 00 00 02 C6 08
							  15 01 00 00 00 00 02 DE 05
							  39 01 00 00 00 00 14 B1 00 00 04 E3 9A 10 11 BF EF 1B 23 23 23 42 00
							                       58 F5 20 00
							  39 01 00 00 00 00 18 B4 80 08 00 32 10 00 00 00 00 00 00 00 37 0A 40
							                       04 37 0A 40 14 50 55 0A
							  39 01 00 00 00 00 08 B2 00 00 78 08 03 3F 80
							  39 01 00 00 00 00 80 C1 01 02 08 17 20 27 2D 32 38 40 48 4F 57 5F 67
							                       70 79 81 89 91 99 A1 A8 B0 B9 C2 C9 D0 D9 E2 E9
							                       F3 FA FF D0 AF DF A9 A9 3D 79 92 C0 02 08 17 20
							                       27 2D 32 38 40 48 4F 57 5F 67 70 79 81 89 91 99
							                       A1 A8 B0 B9 C2 C9 D0 D9 E2 E9 F3 FA FF D0 AF DF
							                       A9 A9 3D 79 92 C0 02 08 17 20 27 2D 32 38 40 48
							                       4F 57 5F 67 70 79 81 89 91 99 A1 A8 B0 B9 C2 C9
							                       D0 D9 E2 E9 F3 FA FF D0 AF DF A9 A9 3D 79 92 C0
							  39 01 00 00 00 00 31 D5 00 00 00 00 01 00 00 00 60 00 99 88 99 88 88
							                       32 88 10 88 76 88 54 10 32 88 88 88 88 88 88 99
							                       88 99 88 45 88 67 88 01 88 23 23 01 88 88 88 88
							                       88
							  39 01 00 00 00 00 23 E0 00 05 06 16 19 24 0C 26 06 09 0C 10 13 0F 13
							                       10 16 10 1E 1F 2F 32 3E 25 3F 06 09 0C 10 13 0F
							                       13 10 16
							  39 01 00 00 00 00 05 B6 00 A5 00 A5
							  15 01 00 00 00 00 02 CC 0E
							  15 01 00 00 00 00 02 E6 00
							  15 01 00 00 00 00 02 E3 0F
							  39 01 00 00 00 00 13 E5 00 00 08 06 04 00 80 20 20 10 00 00 00 00 00
							                       00 80 0A
							  39 01 00 00 00 00 12 E2 40 00 00 05 05 1D 1D 1D 00 00 00 00 00 00 00
							                       00 00
							  39 01 00 00 00 00 03 CB 07 07
							  39 01 00 00 00 00 05 BB 00 00 FF 80
							  05 01 00 00 78 00 02 11 00
							  05 01 00 00 0a 00 02 29 00
							  15 01 00 00 05 00 02 51 FF
  							  15 01 00 00 05 00 02 C6 EC
  							  39 01 00 00 05 00 07 C9 0F 02 1E 1D 00 80
  							  15 01 00 00 05 00 02 55 02
  							  39 01 00 00 05 00 0A CA 2E 2D 2C 2A 28 26 24 22 20
							  15 01 00 00 05 00 02 53 24
							  15 01 00 00 05 00 02 5E 00];

		qcom,mdss-dsi-on-command_lab = [39 01 00 00 00 00 04 B9 FF 83 89
							  39 01 00 00 00 00 03 BA 41 93
							  15 01 00 00 00 00 02 C6 08
							  15 01 00 00 00 00 02 DE 05
							  39 01 00 00 00 00 14 B1 00 00 04 E3 9A 10 11 BF EF 1B 23 23 23 42 00
							                       58 F5 20 00
							  39 01 00 00 00 00 18 B4 80 08 00 32 10 00 00 00 00 00 00 00 37 0A 40
							                       04 37 0A 40 14 50 55 0A
							  39 01 00 00 00 00 08 B2 00 00 78 08 03 3F 80
							  39 01 00 00 00 00 80 C1 01 02 08 17 20 27 2D 32 38 40 48 4F 57 5F 67
							                       70 79 81 89 91 99 A1 A8 B0 B9 C2 C9 D0 D9 E2 E9
							                       F3 FA FF D0 AF DF A9 A9 3D 79 92 C0 02 08 17 20
							                       27 2D 32 38 40 48 4F 57 5F 67 70 79 81 89 91 99
							                       A1 A8 B0 B9 C2 C9 D0 D9 E2 E9 F3 FA FF D0 AF DF
							                       A9 A9 3D 79 92 C0 02 08 17 20 27 2D 32 38 40 48
							                       4F 57 5F 67 70 79 81 89 91 99 A1 A8 B0 B9 C2 C9
							                       D0 D9 E2 E9 F3 FA FF D0 AF DF A9 A9 3D 79 92 C0
							  39 01 00 00 00 00 31 D5 00 00 00 00 01 00 00 00 60 00 99 88 99 88 88
							                       32 88 10 88 76 88 54 10 32 88 88 88 88 88 88 99
							                       88 99 88 45 88 67 88 01 88 23 23 01 88 88 88 88
							                       88
							  39 01 00 00 00 00 23 E0 00 05 06 16 19 24 0C 26 06 09 0C 10 13 0F 13
							                       10 16 10 1E 1F 2F 32 3E 25 3F 06 09 0C 10 13 0F
							                       13 10 16
							  39 01 00 00 00 00 05 B6 00 A5 00 A5
							  15 01 00 00 00 00 02 CC 0E
							  15 01 00 00 00 00 02 E6 00
							  15 01 00 00 00 00 02 E3 0F
							  39 01 00 00 00 00 13 E5 00 00 08 06 04 00 80 20 20 10 00 00 00 00 00
							                       00 80 0A
							  39 01 00 00 00 00 12 E2 40 00 00 05 05 1D 1D 1D 00 00 00 00 00 00 00
							                       00 00
							  39 01 00 00 00 00 03 CB 07 07
							  39 01 00 00 00 00 05 BB 00 00 FF 00
							  05 01 00 00 78 00 02 11 00
							  05 01 00 00 0a 00 02 29 00
							  15 01 00 00 05 00 02 51 FF
  							  15 01 00 00 05 00 02 C6 EC
  							  39 01 00 00 05 00 07 C9 0F 02 1E 1D 00 80
  							  15 01 00 00 05 00 02 55 02
  							  39 01 00 00 05 00 0A CA 2E 2D 2C 2A 28 26 24 22 20
							  15 01 00 00 05 00 02 53 24
							  15 01 00 00 05 00 02 5E 00];

		qcom,mdss-dsi-on-command_refresh = [
							  39 01 00 00 00 00 04 B9 FF 83 89
							  39 01 00 00 00 00 03 BA 41 93
							  15 01 00 00 00 00 02 C6 08
							  15 01 00 00 00 00 02 DE 05
							  39 01 00 00 00 00 14 B1 00 00 04 E3 9A 10 11 8F EF 28 30 23 23 42 00
							                       2A FF 20 00
							  39 01 00 00 00 00 18 B4 80 08 00 32 10 00 00 00 00 00 00 00 37 0A 40
							                       04 37 0A 40 14 50 55 0A
							  39 01 00 00 00 00 08 B2 00 00 78 08 03 3F 80
							  39 01 00 00 00 00 31 D5 00 00 4C 00 01 00 00 00 60 00 99 88 99 88 88
							                       32 88 10 88 76 88 54 10 32 88 88 88 88 88 88 99
							                       88 99 88 45 88 67 88 01 88 23 23 01 88 88 88 88
							                       88
							  39 01 00 00 00 00 23 E0 05 14 18 2D 34 3F 20 3C 08 0E 0E 11 13 10 12
							                       1A 1C 05 14 18 2D 34 3F 20 3C 08 0E 0E 11 13 10
							                       12 1A 1C
							  39 01 00 00 00 00 05 B6 00 A5 00 A5
							  15 01 00 00 00 00 02 CC 0E
							  39 01 00 00 00 00 03 CB 07 07
							  39 01 00 00 00 00 05 BB 00 00 FF 80
							  05 01 00 00 78 00 02 11 00
							  05 01 00 00 0a 00 02 29 00];
		qcom,mdss-dsi-off-command = [05 01 00 00 32 00 02 28 00
					05 01 00 00 78 00 02 10 00];
		qcom,mdss-dsi-on-command-state = "dsi_lp_mode";
		qcom,mdss-dsi-off-command-state = "dsi_hs_mode";
		qcom,mdss-dsi-h-sync-pulse = <1>;
		qcom,mdss-dsi-traffic-mode = "non_burst_sync_pulse";
		qcom,mdss-dsi-lane-map = "lane_map_0123";
		qcom,mdss-dsi-bllp-eof-power-mode;
		qcom,mdss-dsi-bllp-power-mode;
		qcom,mdss-dsi-force-clk-hs;
		qcom,mdss-dsi-lane-0-state;
		qcom,mdss-dsi-lane-1-state;
		qcom,mdss-dsi-lane-2-state;
		/* qcom,mdss-dsi-lane-3-state;*/
		qcom,mdss-dsi-panel-timings = [55 12 0c 00 32 36 10 16 0f 03 04 00];
		qcom,mdss-dsi-t-clk-post = <0x05>;
		qcom,mdss-dsi-t-clk-pre = <0x14>;
		qcom,mdss-dsi-bl-min-level = <1>;
		qcom,mdss-dsi-bl-max-level = <4095>;
		qcom,mdss-dsi-dma-trigger = "trigger_sw";
		qcom,mdss-dsi-mdp-trigger = "none";
		qcom,mdss-dsi-bl-pmic-control-type = "bl_ctrl_wled";
		qcom,mdss-dsi-reset-sequence = <1 20>, <0 1>, <1 20>;
		qcom,mdss-pan-physical-width-dimension = <59>;
		qcom,mdss-pan-physical-height-dimension = <104>;

	};
};
